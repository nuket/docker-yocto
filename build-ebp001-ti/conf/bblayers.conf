## build-ebp001-ti/conf/bblayers.conf
```bitbake
# POKY_BBLAYERS_CONF_VERSION is increased each time build/conf/bblayers.conf
# changes incompatibly
POKY_BBLAYERS_CONF_VERSION = "2"

BBPATH = "${TOPDIR}"
BSPDIR := "${@os.path.abspath(os.path.dirname(d.getVar('FILE', True)) + '/../..')}"

BBFILES ?= ""
BBLAYERS ?= " \
  ${BSPDIR}/sources/poky/meta \
  ${BSPDIR}/sources/poky/meta-poky \
  ${BSPDIR}/sources/poky/meta-yocto-bsp \
  ${BSPDIR}/sources/meta-arm/meta-arm \
  ${BSPDIR}/sources/meta-arm/meta-arm-toolchain \
  ${BSPDIR}/sources/meta-clang \
  ${BSPDIR}/sources/meta-arago/meta-arago-distro \
  ${BSPDIR}/sources/meta-arago/meta-arago-extras \
  ${BSPDIR}/sources/meta-arago/meta-arago-test \
  ${BSPDIR}/sources/meta-ti/meta-ti-extras \
  ${BSPDIR}/sources/meta-ti/meta-ti-bsp \
  ${BSPDIR}/sources/meta-openembedded/meta-networking \
  ${BSPDIR}/sources/meta-openembedded/meta-python \
  ${BSPDIR}/sources/meta-openembedded/meta-oe \
  ${BSPDIR}/sources/meta-openembedded/meta-filesystems \
  ${BSPDIR}/sources/meta-openembedded/meta-multimedia \
  ${BSPDIR}/sources/meta-qt6 \
  ${BSPDIR}/sources/meta-swupdate \
  ${BSPDIR}/sources/meta-testo-ti \
  ${BSPDIR}/sources/meta-testo-userspace \
"

#  ${BSPDIR}/sources/meta-virtualization
#  ${BSPDIR}/sources/meta-openembedded/meta-gnome
#  ${BSPDIR}/sources/oe-core/meta
#  ${BSPDIR}/sources/meta-testo
#  ${BSPDIR}/sources/meta-swupdate
```
